## drivers/Kconfig
```kconfig
# SPDX-License-Identifier: Apache-2.0

rsource "wifi_log/Kconfig"
rsource "sensor/Kconfig"
```

## drivers/sensor/voltage_monitor/Kconfig
```kconfig
# SPDX-License-Identifier: Apache-2.0

config VOLTAGE_MONITOR
	bool "Voltage monitor sensor"
	default y
	depends on DT_HAS_APP_VOLTAGE_MONITOR_ENABLED
	help
	  Enable voltage monitor sensor driver.
	  Select the data source backend below.

if VOLTAGE_MONITOR

choice VMON_BACKEND
	prompt "Voltage monitor data source"
	optional
	help
	  Select how the voltage monitor acquires its data.

	  IMPORTANT: You MUST explicitly enable one backend in prj.conf:
	    CONFIG_VMON_BACKEND_ADC=y    (internal ADC)
	    CONFIG_VMON_BACKEND_I2C=y    (external I2C sensor)

	  The required subsystem (ADC or I2C) must also be enabled.
	  If neither is set, the build will fail with #error.

config VMON_BACKEND_ADC
	bool "Internal ADC"
	depends on ADC
	help
	  Read voltage from an internal ADC peripheral (io-channels).
	  Requires CONFIG_ADC=y in prj.conf.

config VMON_BACKEND_I2C
	bool "External I2C sensor"
	depends on I2C
	help
	  Read voltage from an I2C-connected sensor (INA219, INA226,
	  ADS1115, or any I2C voltage source).
	  Requires CONFIG_I2C=y in prj.conf.

endchoice

if VMON_BACKEND_I2C

config VMON_I2C_READ_BYTES
	int "I2C read length (bytes)"
	default 4
	range 1 8
	help
	  Number of bytes to read from the I2C sensor. Raw bytes are
	  assembled into a uint32_t in little-endian order.

config VMON_I2C_SCALE_NUM
	int "Raw → mV numerator"
	default 1
	help
	  Numerator of the scaling factor: mV = raw * NUM / DEN.
	  Default 1 means raw value is already in mV.

config VMON_I2C_SCALE_DEN
	int "Raw → mV denominator"
	default 1
	help
	  Denominator of the scaling factor: mV = raw * NUM / DEN.
	  Default 1 means raw value is already in mV.

endif # VMON_BACKEND_I2C

endif # VOLTAGE_MONITOR
```

## drivers/wifi_log/Kconfig
```kconfig
config APP_WIFI_LOG
    bool "Wi-Fi Log Driver"
    default y
    help
      Sends app trace logs over Wi-Fi via TCP to a remote server.

if APP_WIFI_LOG

config APP_WIFI_LOG_SSID
    string "Wi-Fi SSID"
    default "MyWiFi"
    help
      SSID of the Wi-Fi network to connect to.

config APP_WIFI_LOG_PSK
    string "Wi-Fi Password"
    default "password123"
    help
      Pre-shared key (password) for WPA/WPA2.

config APP_WIFI_LOG_SERVER_IP
    string "Log server IP address"
    default "192.168.1.100"
    help
      IPv4 address of the TCP log server.

config APP_WIFI_LOG_SERVER_PORT
    int "Log server TCP port"
    default 5555
    help
      TCP port on which the log server listens.

endif # APP_WIFI_LOG
```

## lib/Kconfig
```kconfig
# SPDX-License-Identifier: Apache-2.0

config APP_UTILS
	bool "Application Utility Library"
	default y
	help
	  Common utility functions used across the application.
```

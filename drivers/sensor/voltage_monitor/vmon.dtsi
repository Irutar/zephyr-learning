/*
 * SPDX-License-Identifier: Apache-2.0
 *
 * Voltage monitor — module devicetree TEMPLATE.
 *
 * Copy this file to your project, then DELETE the sections for
 * peripherals your board DOES NOT have:
 *   - No ADC?  → delete the ADC block below.
 *   - No I2C?  → delete the I2C block below.
 *   - Both?    → keep both, pick backend via Kconfig.
 *
 * Peripheral enabling (&adc0, &i2c0) belongs in the board overlay.
 */

/ {
	vmon: voltage-monitor {
		compatible = "app,voltage-monitor";
		status = "okay";

		/*
		 * === ADC BACKEND ===================================
		 * DELETE this block if your board has no ADC.
		 */
		io-channels = <&adc0 6>;		/* zmień kanał */
		zephyr,gain = "ADC_GAIN_1_4";
		zephyr,reference = "ADC_REF_INTERNAL";
		zephyr,acquisition-time = <ADC_ACQ_TIME_DEFAULT>;
		zephyr,resolution = <12>;

		/*
		 * === I2C BACKEND ===================================
		 * DELETE this block if your board has no I2C.
		 */
		i2c-bus = <&i2c0>;			/* zmień bus */
		i2c-addr = <0x20>;			/* zmień adres */
	};
};
